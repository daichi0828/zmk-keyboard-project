## boards/arm/d_keyboard/Kconfig.board
```kconfig
config BOARD_D_KEYBOARD
    bool "D Keyboard (ZMK Variant)"
    select ZMK_BOARD_COMPAT
```

## boards/shields/D_Keyboard/Kconfig.defconfig
```kconfig
if SHIELD_D_KEYBOARD_R

config ZMK_KEYBOARD_NAME
    default "D-Keyboard_R"

config ZMK_SPLIT_ROLE_CENTRAL
    default y

config ZMK_SPLIT_BLE_CENTRAL
    default y

config ZMK_MOUSE
    default y

config ZMK_POINTING
    default y

config SPI
    default y

config INPUT_PMW3610
    default y

config PMW3610
    bool "Enable PMW3610 support"
    default y

config PMW3610_SWAP_XY
    bool "Swap X and Y axes for PMW3610"
    default y

config ZMK_USB
    default y

config USB_DEVICE_PRODUCT
    default "D-Keyboard"

config USB_DEVICE_STACK
    default y

endif


if SHIELD_D_KEYBOARD_L

config ZMK_KEYBOARD_NAME
    default "D-Keyboard_L"

config ZMK_SPLIT_ROLE_PERIPHERAL
    bool
    default y

config ZMK_SPLIT_BLE_PERIPHERAL
    bool
    default y

endif


if SHIELD_D_KEYBOARD_R || SHIELD_D_KEYBOARD_L

config ZMK_SPLIT
    default y

config BT
    default y

config ZMK_BLE
    default y

config INPUT
    default y

config RGBLED_WIDGET_BATTERY_LEVEL_HIGH
    default 30

config RGBLED_WIDGET_BATTERY_LEVEL_CRITICAL
    default 10

endif
```

## boards/shields/tweakbit/Kconfig.shield
```kconfig
config SHIELD_D-KEYBOARD_R
    def_bool $(shields_list_contains,D-Keyboard_r)

config SHIELD_D-KEYBOARD_L
    def_bool $(shields_list_contains,D-Keyboard_l)
```

## config/boards/shields/D_Keyboard /Kconfig.shield
```kconfig
config SHIELD_D_KEYBOARD_R
    def_bool $(shields_list_contains,D_Keyboard_r)

config SHIELD_D_KEYBOARD_L
    def_bool $(shields_list_contains,D_Keyboard_l)

config ZMK_SPLIT_BLE_CENTRAL
    bool "Enable BLE central role for split keyboards"
```

## config/west.yml
```yaml
manifest:
  remotes:
    - name: zmkfirmware
      url-base: https://github.com/zmkfirmware
    - name: sayu-hub
      url-base: https://github.com/sayu-hub
    - name: badjeff    # <-- PMW3610
      url-base: https://github.com/badjeff
    - name: caksoylar  # <-- RGB LED
      url-base: https://github.com/caksoylar  
    - name: daichi0828
      url-base: https://github.com/daichi0828   
  projects:
    - name: zmk
      remote: zmkfirmware
      revision: v0.3.0
      import: app/west.yml
    - name: zmk-pmw3610-driver
      remote: badjeff
      revision: zmk-0.3
    - name: zmk-rgbled-widget
      remote: caksoylar
      revision: v0.3
  #  - name: zmk-keyboard-project
  #    remote: daichi0828  # または自分のGitHubユーザー名に合わせて
  #    revision: main
  #    path: zmk-keyboard-project
  self:
    path: config
    path: zmk-keyboard-project
```
